## conf/layer.conf
```bitbake
# We have a conf and classes directory, add to BBPATH
BBPATH .= ":${LAYERDIR}"

# We have recipes-* directories, add to BBFILES
BBFILES += "${LAYERDIR}/recipes-*/*/*.bb \
    ${LAYERDIR}/recipes-*/*/*.bbappend"

BBFILE_COLLECTIONS += "artik710-bsp"
BBFILE_PATTERN_artik710-bsp = "^${LAYERDIR}/"
BBFILE_PRIORITY_artik710-bsp = "6"

LAYERDEPENDS_-artik710-bsp = "core"
```

## conf/machine/artik710.conf
```bitbake
#@TYPE: Machine
#@NAME: Samsung Artik 710
#@SOC:ARM Cortex-A53
#@DESCRIPTION: Machine configuration for Samsung Artik 710

require conf/machine/include/artik.inc
require conf/machine/include/arm/arch-armv8.inc

PREFERRED_PROVIDER_u-boot = "u-boot-artik710"
PREFERRED_PROVIDER_virtual/kernel = "linux-yocto-artik710"

# Kernel
KERNEL_DEVICETREE ?= " \
    nexell/s5p6818-artik710-raptor-rev00.dtb \
    nexell/s5p6818-artik710-raptor-rev01.dtb \
    nexell/s5p6818-artik710-raptor-rev03.dtb \
    "
KERNEL_IMAGETYPE = "Image"
KBUILD_DEFCONFIG = "artik710_raptor_defconfig"

# Use uboot_mkimage
UBOOT_ENTRYPOINT = "0x40080000"
KEEPUIMAGE = "no"

# U-boot
UBOOT_MACHINE = "artik710_raptor_config"

BASE_MACH = "s5p6818"
FIP_LOAD_ADDR = "0x7df00000"

# bl1 for SD and eMMC boot (a.k.a. AP Boot ROM: AP_BL1, in our case bl1-emmcboot.img and bl1-sdboot.img)
# bl2 for SD and eMMC boot (a.k.a. AP RAM Firmware: AP_BL2, in our case fip-loader-emmc.img and fip-loader-sd.img)
# bl31 + bl32 (a.k.a. EL3 Runtime Firmware or SoC AP firmware or EL3 monitor firmware: AP_BL31 + Secure-EL1 Payload (SP): AP_BL32, in our case the bundled image fip-secure.img consisting of the ATF + secure OS OPTEE)
# bl33 (a.k.a. AP Normal World Firmware: AP_BL33, in our case the uboot binary transformed to a FIP - Firmware Image Package - and then into a nexell image using SECURE_BINGEN)
BL1_EMMC = "bl1-emmcboot.img"
BL1_SD = "bl1-sdboot.img"
BL2_EMMC = "fip-loader-emmc.img"
BL2_SD = "fip-loader-sd.img"
BL31 = "fip-secure.img"
BL33 = "fip-nonsecure.img"

# Offsets for generating the final image
BL1_OFFSET = "1"
BL2_OFFSET = "129"
TZSW_OFFSET = "769"
UBOOT_OFFSET = "3841"
ENV_OFFSET = "5889"

SERIAL_CONSOLE = "115200 ttySAC3"

# Artik 710 uses another firmware for WiFi and BT
MACHINE_ESSENTIAL_EXTRA_RRECOMMENDS_remove = "bcm4354-nvram-config"
MACHINE_ESSENTIAL_EXTRA_RRECOMMENDS_remove = "bcm4354-bt"
MACHINE_ESSENTIAL_EXTRA_RRECOMMENDS += "bcm43455c0-wifi"
MACHINE_ESSENTIAL_EXTRA_RRECOMMENDS += "bcm4345-bt"
module_conf_dhd = "options dhd firmware_path=/etc/wifi/fw.bin nvram_path=/etc/wifi/nvram.txt"

MACHINE_FEATURES += " usbhost"
```

## conf/machine/kitra710.conf
```bitbake
#@TYPE: Machine
#@NAME: RushUp Kitra 710
#@SOC:ARM Cortex-A53
#@DESCRIPTION: Machine configuration for RushUp Kitra 710

MACHINEOVERRIDES = "artik710:${MACHINE}"
include conf/machine/artik710.conf

PREFERRED_PROVIDER_virtual/kernel = "linux-yocto-kitra710"

KBUILD_DEFCONFIG = "kitra710_defconfig"
```
